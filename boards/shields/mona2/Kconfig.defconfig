## boards/shields/mona2/Kconfig.defconfig
```kconfig
if SHIELD_MONA2_DONGLE

config ZMK_KEYBOARD_NAME
    default "mona2"

config ZMK_SPLIT_ROLE_CENTRAL
    default y

config ZMK_SPLIT
    default y

config ZMK_SPLIT_BLE_CENTRAL_PERIPHERALS
    default 2

config BT_MAX_CONN
    default 3

config BT_MAX_PAIRED
    default 3

endif

if SHIELD_MONA2_R || SHIELD_MONA2_L

config NFCT_PINS_AS_GPIOS
    default y

config ZMK_SPLIT
    default y

endif
```

## config/west.yml
```yaml
manifest:
  remotes:
    - name: zmkfirmware
      url-base: https://github.com/zmkfirmware
    - name: sayu-hub
      url-base: https://github.com/sayu-hub
    - name: badjeff    # <-- PMW3610
      url-base: https://github.com/badjeff
    - name: sekigon-gonnoc  # <-- PAW3222
      url-base: https://github.com/sekigon-gonnoc
    - name: tttuemura
      url-base: https://github.com/tttuemura
    - name: caksoylar  # <-- RGB LED
      url-base: https://github.com/caksoylar  
    - name: zettaface  # <-- Input Processor Keybind
      url-base: https://github.com/zettaface
    - name: rschenk  # <-- dongle
      url-base: https://github.com/rschenk
    - name: BP
      url-base: https://github.com/taichan1113
  projects:
    - name: zmk
      remote: zmkfirmware
      revision: main
      import: app/west.yml
    - name: zmk-driver-paw3222
      remote: sekigon-gonnoc
      revision: main
    - name: zmk-rgbled-widget
      remote: caksoylar
      revision: main
    # - name: zmk-input-processor-keybind
    #   remote: zettaface
    #   revision: main
    - name: zmk-component-raytac-dongle
      remote: rschenk
      revision: v0.4
  self:
    path: config
```
